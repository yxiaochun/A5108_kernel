/*
 * SAMSUNG UNIVERSAL5430 board device tree source
 *
 * Copyright (c) 2013 Samsung Electronics Co., Ltd.
 *		http://www.samsung.com
 *
 * This program is free software; you can redistribute it and/or modify
 * it under the terms of the GNU General Public License version 2 as
 * published by the Free Software Foundation.
*/

#include "exynos7580-a5xelte_battery_02.dtsi"
/ {
	battery {
		battery,full_check_current_2nd = <145 0 0 145 145 145 145 145 145 0 145 145 145 0 0 145 145 145 145 145 145 0 145 145 145 0 145 145 145 0 145>;

		battery,swelling_high_temp_block = <500>;
		battery,swelling_high_temp_recov = <450>;
		battery,swelling_low_temp_block = <50>;
		battery,swelling_low_temp_recov = <100>;
		battery,swelling_chg_current = <1450>;
		battery,swelling_high_chg_current = <0>;
		battery,swelling_low_chg_current = <0>;
		battery,swelling_full_check_current_2nd = <0>;
		battery,swelling_drop_float_voltage = <4200>;
		battery,swelling_high_rechg_voltage = <4150>;
		battery,swelling_low_rechg_voltage = <4050>;
	};
};
